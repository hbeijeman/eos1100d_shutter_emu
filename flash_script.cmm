;&flashsize=256.
;&ramsize=32.
;&flashsize=1024.
&ramsize=128.

;========================================================================
; CPU setup

  sys.down
  SYStem.RESet
  SYStem.CPU STM32F042C6
  SYStem.OPTION IMASKASM ON
  SYStem.OPTION DUALPORT ON
  SYStem.CONFIG DEBUGPORTTYPE SWD
  SYStem.CONFIG CONNECTOR MIPI20T
  system.JtagClock 1MHz
  ;itm.reset
  ;do common
  ;ca.mode fifo
  ;ca.init
  SYStem.Up

;========================================================================
; Flash declaration




; FLASH.List

;========================================================================
; Flash programming example
;
DIALOG.YESNO "Program flash memory?"
LOCAL &progflash
ENTRY &progflash
LOCAL &param_dualport
&param_dualport=1

  FLASH.RESet
  GOSUB FlashDeclaration &param_dualport

if &progflash
(
  DIALOG.YESNO "Erase flash memory first?"
  LOCAL &eraseflash
  ENTRY &eraseflash

  if &eraseflash
  (
    FLASH.erase 1.
  )
  FLASH.auto 1.
  Data.LOAD.auto main.elf /WORD
  FLASH.Program off
)

symbol.SOURCEPATH.SETRECURSEDIR .
Data.LOAD.auto main.elf /nocode
Data.LOAD.auto main.elf /VM


; Initialize CMX Awareness
; Note that the CMX awareness needs the kernel symbols to work
 
;ca.
;winpos 0% 31% 30% 68%
;ca.l /Track
;winpos 31% 27. 68% 8.
;ca.chart /Track


; Slect the Analyzer (PowerTrace with Preprocessor)
Trace.Method CAnalyzer   ; Using CombiProbe  
Trace.Off                ; Enable the trace and turn it off

mode.hll
d.l

system.resetout

ENDDO


;========================================================================
; Flash declaration depending on selected CPU 


FlashDeclaration:
  LOCAL &DualPort
  ENTRY &DualPort

  LOCAL &FlashSize

  IF CPUIS("STM32F04??4")
    &FlashSize=0x4000
  ELSE IF CPUIS("STM32F04??6")
    &FlashSize=0x8000
  ELSE
  (
    PRINT %ERROR "FLASH size of CPU type is unknown"
    ENDDO
  )

  IF &FlashSize>=0x4000
    FLASH.Create 1. 0x08000000--0x08003FFF 0x400 TARGET Word
  IF &FlashSize>=0x8000
    FLASH.Create 1. 0x08004000--0x08007FFF 0x400 TARGET Word
  IF &FlashSize>=0x10000
    FLASH.Create 1. 0x08008000--0x0800FFFF 0x400 TARGET Word

  ; For Main Flash memory boot mode flash memory is aliased to address 0x0
  ; Because SYSCFG_CFGR1:MEM_MODE[1:0] is not indicating active memory remap
  ; we are comparing flash reset vector against reset vector at alias address
  Data.ComPare 0x0--0x7 0x08000000
  IF !FOUND()
    FLASH.CreateALIAS 0x0000--0xFFFF 0x08000000

  IF &DualPort==0
    FLASH.TARGET 0x20000000 0x20000800 0x400 ./src/stm32f0xx_lib/stm32f0.bin
  ELSE
    FLASH.TARGET 0x20000000 EAHB:0x20000800 0x400 ./src/stm32f0xx_lib/stm32f0.bin /DualPort

  RETURN



